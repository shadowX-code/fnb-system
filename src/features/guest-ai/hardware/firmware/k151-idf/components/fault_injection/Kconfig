## src/features/guest-ai/hardware/firmware/k151-idf/components/fault_injection/Kconfig
```kconfig
config FEEDX_GUEST_AI_FAULT_INJECTION
    bool "Enable Guest AI on-device reliability fault injection"
    default n
    help
        Test-firmware only. Enables RAM-only one-shot camera/USB faults.
```

## src/features/guest-ai/hardware/firmware/k151-idf/sdkconfig.defaults
```kconfig
CONFIG_IDF_TARGET="esp32s3"
CONFIG_ESPTOOLPY_FLASHSIZE_16MB=y
CONFIG_ESPTOOLPY_FLASHMODE_QIO=y
CONFIG_PARTITION_TABLE_CUSTOM=y
CONFIG_SPIRAM=y
CONFIG_SPIRAM_SPEED_80M=y
CONFIG_ESP_VIDEO_ENABLE_DVP_VIDEO_DEVICE=y
CONFIG_CAMERA_GC0308=y
CONFIG_CAMERA_GC0308_DVP_YUV422_320X240_20FPS=y
CONFIG_CODEC_ES7210_SUPPORT=y
CONFIG_CODEC_AW88298_SUPPORT=y
```
